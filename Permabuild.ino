#include <TouchLib.h> 
#include<Servo.h>


/* Using
 * TLSensor.h - Capacitive sensing library based on TL method for Arduino
 * https://github.com/AdmarSchoonen/TLSensor
 * Copyright (c) 2016, 2017 Admar Schoonen
 *
 * Redistribution and use in source and binary forms, with or without
 * modification, are permitted provided that the following conditions are met:
 *     * Redistributions of source code must retain the above copyright
 *       notice, this list of conditions and the following disclaimer.
 *     * Redistributions in binary form must reproduce the above copyright
 *       notice, this list of conditions and the following disclaimer in the
 *       documentation and/or other materials provided with the distribution.
 *     * Neither the name of the <organization> nor the
 *       names of its contributors may be used to endorse or promote products
 *       derived from this software without specific prior written permission.
 * 
 * THIS SOFTWARE IS PROVIDED BY THE COPYRIGHT HOLDERS AND CONTRIBUTORS "AS IS"
 * AND ANY EXPRESS OR IMPLIED WARRANTIES, INCLUDING, BUT NOT LIMITED TO, THE
 * IMPLIED WARRANTIES OF MERCHANTABILITY AND FITNESS FOR A PARTICULAR PURPOSE
 * ARE DISCLAIMED. IN NO EVENT SHALL <COPYRIGHT HOLDER> BE LIABLE FOR ANY
 * DIRECT, INDIRECT, INCIDENTAL, SPECIAL, EXEMPLARY, OR CONSEQUENTIAL DAMAGES
 * (INCLUDING, BUT NOT LIMITED TO, PROCUREMENT OF SUBSTITUTE GOODS OR SERVICES;
 * LOSS OF USE, DATA, OR PROFITS; OR BUSINESS INTERRUPTION) HOWEVER CAUSED AND
 * ON ANY THEORY OF LIABILITY, WHETHER IN CONTRACT, STRICT LIABILITY, OR TORT
 * (INCLUDING NEGLIGENCE OR OTHERWISE) ARISING IN ANY WAY OUT OF THE USE OF THIS
 * SOFTWARE, EVEN IF ADVISED OF THE POSSIBILITY OF SUCH DAMAGE.
 */
/*
 * Code generated by TouchLib SemiAutoTuning.
 *
 * Hardware configuration:
 * 
  */
/*FSR  A0 GND
//Servo 0: Digital Pin 2
//LED: Digital Pin 3
//LED: Digital Pin 4
//LED: Digital Pin 7
//Capacitive Sensor 1: A1
//Capacitive Sensor 2: A2
//Capacitive Sensor 3: A3
//Tiny vibrating motor disc: Digital Pin 5
//Servo 1: Digital Pin 6
//Servo 2: Digital Pin 8
*/
 
 
 

/*
 *  Number of sensors. For capacitive sensors: needs to be a minimum of 2. When
 * using only one sensor, set N_SENSORS to 2 and use an unused analog input pin
 * for the second
 * sensor. For 2 or more sensors you don't need to add an unused analog input.
 */
#define N_SENSORS                       3

/*
 * Number of measurements per sensor to take in one cycle. More measurements
 * means more noise reduction / spreading, but is also slower.
 */
#define N_MEASUREMENTS_PER_SENSOR       16

/* tlSensors is the actual object that contains all the sensors */
TLSensors<N_SENSORS, N_MEASUREMENTS_PER_SENSOR> tlSensors;

int incomingByte = 0;

int servo0Pin = 2;
int servo1Pin = 6;
int servo2Pin = 8;

Servo servo0;
Servo servo1; 
Servo servo2;


int LEDPinR = 3;
int LEDPinL = 4;
int LEDPinE = 7;

int vibPin = 5;

int FSRPin = A0;
int valueFSRRead = 0;  

int stressCount = 0;


void setup()
{
        Serial.begin(9600);

        while(!Serial); /* Required for ATmega32u4 processors */

        /* Delay to make sure serial monitor receives first message */
        delay(500);
        Serial.println();
        Serial.println();
        Serial.println("Switching baudrate to 115200. Make sure to adjust baudrate in serial monitor as well!");
        Serial.println();
        Serial.println();
        Serial.end();

        /*
         * Switch baudrate to highest baudrate available. With higher baudrate,
         * CPU has more time left to do capacitive sensing and thus get better
         * signal quality.
         */
        Serial.begin(115200);
        delay(500);
        Serial.println();
        Serial.println();

        /*
         * Configuration for sensor 1:
         * Type: capacitive (CVD method)
         * Analog pin: A1
         */
        tlSensors.initialize(0, TLSampleMethodCVD);
        tlSensors.data[0].tlStructSampleMethod.CVD.pin =               A1;
        tlSensors.data[0].releasedToApproachedThreshold =              37.78;
        tlSensors.data[0].approachedToReleasedThreshold =              34.00;
        tlSensors.data[0].approachedToPressedThreshold =               142.32;
        tlSensors.data[0].pressedToApproachedThreshold =               128.08;
        tlSensors.data[0].calibratedMaxDelta =                         1332.53;
        tlSensors.data[0].enableSlewrateLimiter =                      false;

        /*
         * Configuration for sensor 2:
         * Type: capacitive (CVD method)
         * Analog pin: A2
         */
        tlSensors.initialize(1, TLSampleMethodCVD);
        tlSensors.data[1].tlStructSampleMethod.CVD.pin =               A2;
        tlSensors.data[1].releasedToApproachedThreshold =              5.00;
        tlSensors.data[1].approachedToReleasedThreshold =              4.00;
        tlSensors.data[1].approachedToPressedThreshold =               2350.41;
        tlSensors.data[1].pressedToApproachedThreshold =               2115.37;
        tlSensors.data[1].calibratedMaxDelta =                         4790.89;
        tlSensors.data[1].enableSlewrateLimiter =                      false;


        /*
         * Configuration for sensor 3:
         * Type: capacitive (CVD method)
         * Analog pin: A3
         */
       tlSensors.initialize(2, TLSampleMethodCVD);
        tlSensors.data[2].tlStructSampleMethod.CVD.pin =               A3;
        tlSensors.data[2].releasedToApproachedThreshold =              2800.12;
        tlSensors.data[2].approachedToReleasedThreshold =              3500.55;
        tlSensors.data[2].approachedToPressedThreshold =               6700.32;
        tlSensors.data[2].pressedToApproachedThreshold =               5280.08;
        tlSensors.data[2].calibratedMaxDelta =                         7320.53;
        tlSensors.data[2].enableSlewrateLimiter =                      false;
        
        if (tlSensors.error) {
                Serial.println("Error detected during initialization of TouchLib. This is probably a bug; please notify the author.");
                while (1);
        }

        Serial.println("Calibrating sensors...");
        while(tlSensors.anyButtonIsCalibrating()) {
                tlSensors.sample();
        }
        Serial.println("Calibration done...");


        //Servo Setup
        servo0.attach(servo0Pin);
        servo1.attach(servo1Pin);
        servo2.attach(servo2Pin);


        //LED setup
        pinMode(LEDPinR, OUTPUT);
        pinMode(LEDPinL, OUTPUT);
        pinMode(LEDPinE, OUTPUT);
        
        //Vibrator SETUP
        pinMode(vibPin, OUTPUT);

}

#define BAR_LENGTH                     58 /* <-- Change this to print longer or
shorter visualizations */

void loop(void)
{
        //Serial Monitor Controls
        if (Serial.available() >= 0) {  // read the incoming byte:
          incomingByte = Serial.read();
        }
        if (incomingByte == '0') {
                Serial.println("Stopping Loop.");
                while (1);
        }
        
  
        //Read FSR
         valueFSRRead = analogRead(FSRPin);       //Read and save analog value from FSR (0-1023) 
                                                  //use value = map(0,1023, 0,255) to get value for led (as ref: http://www.instructables.com/id/How-to-use-a-Force-Sensitive-Resistor-Arduino-Tuto/)
      


        //Based on FSR Value do the following:
        if (valueFSRRead <= 10)
        {
                Serial.println("Hard Squeeze.");
                digitalWrite(LEDPinR,HIGH);
                digitalWrite(LEDPinL,HIGH);
                blinkLEDEyes(10,3);
               //Hard Squeeze
        }
        if (valueFSRRead > 10 && valueFSRRead < 110)
        {
                Serial.println("Medium Squeeze.");
                blinkLEDEyes(40,4);
                //Medium Squeeze
        }
        else if (valueFSRRead >= 110 && valueFSRRead < 120)
        {
                Serial.println("Small Squeeze.");
                blinkLEDEyes(500,2);
               //Small Squeeze
        }
        else if (valueFSRRead >= 120)
        {
          //Reset Any Values
                servo0.write(0);
                servo1.write(0);
                servo2.write(0);
                Serial.println("Nothing"); 
                digitalWrite(LEDPinR,LOW);
                digitalWrite(LEDPinL,LOW);             
        }


        //Capacitor Sensors
        int k;
        int n = 2; /* <-- Change this number to view a different sensor */
        //0,1,2

        //Always call to get information
        tlSensors.sample(); /* <-- Take a series of new samples for all sensors*/

        /*
         * 
         * Reference 
         * 
           buttonStateReleased = 3,
           buttonStateReleasedToApproached = 4,
           buttonStateApproached = 5,
           buttonStateApproachedToPressed = 6,
           buttonStateApproachedToReleased = 7,
           buttonStatePressed = 8,
           buttonStatePressedToApproached = 9,
         */
        //Check Capcitive Sensor 0//Top of head
        if (tlSensors.getState(8));
        {

          
        }
        
          
          
          tlSensors.printBar(n, BAR_LENGTH); /* <-- Print the visualization */
          float val = tlSensors.getValue(n);
          Serial.println(val);
          print_sensor_state(n); /* <-- Print summary of sensor n */
          
 
        Serial.println("");
        delay(50);

}

void blinkLEDEyes(int ms, int num_times)
{
        for (int i = 0; i< num_times; i++){

                digitalWrite(LEDPinR,HIGH);
                digitalWrite(LEDPinL,HIGH);
                delay(ms);
                digitalWrite(LEDPinR,LOW);
                digitalWrite(LEDPinL,LOW);             
        }
  
}

void changePosition(Servo s, int newPos)
{
        int pos = 0;
        for (pos = 0; pos <= newPos; pos += 1) { // goes from 0 degrees to 180 degrees
          // in steps of 1 degree
          s.write(pos);
          delay(15);                       // waits 15ms for the servo to reach the position
        }
        for (pos = newPos; pos >= 0; pos -= 1) { // goes from 180 degrees to 0 degrees
          s.write(pos);
          delay(15);                       // waits 15ms for the servo to reach the position
        }
}


void print_sensor_state(int n)
{
        char s[32] = {'\0'};

        Serial.print(" #");
        Serial.print(n);
        Serial.print(": ");
        Serial.print(tlSensors.isCalibrating(n));
        Serial.print(" ");
        Serial.print(tlSensors.isReleased(n));
        Serial.print(" ");
        Serial.print(tlSensors.isApproached(n));
        Serial.print(" ");
        Serial.print(tlSensors.isPressed(n));
        Serial.print(" ");
        Serial.print(tlSensors.getState(n));
        Serial.print(" ");
        Serial.print(tlSensors.getStateLabel(n));
        memset(s, '\0', sizeof(s));
        memset(s, ' ', 22 - strlen(tlSensors.getStateLabel(n)));
        Serial.print(s);
}

